## sources/base/conf/bblayers.conf
```bitbake
POKY_BBLAYERS_CONF_VERSION = "2"

BBPATH = "${TOPDIR}"
BSPDIR := "${@os.path.abspath(os.path.dirname(d.getVar('FILE', True)) + '/../..')}"

BBFILES ?= ""
BBLAYERS = " \
  ${BSPDIR}/sources/poky/meta \
  ${BSPDIR}/sources/poky/meta-poky \
  \
  ${BSPDIR}/sources/meta-openembedded/meta-oe \
  ${BSPDIR}/sources/meta-openembedded/meta-multimedia \
  ${BSPDIR}/sources/meta-openembedded/meta-xfce \
  \
  ${BSPDIR}/sources/meta-freescale \
  ${BSPDIR}/sources/meta-freescale-3rdparty \
  ${BSPDIR}/sources/meta-freescale-distro \
  ${BSPDIR}/sources/meta-browser \
  ${BSPDIR}/sources/meta-openembedded/meta-gnome \
  ${BSPDIR}/sources/meta-openembedded/meta-python \
  ${BSPDIR}/sources/meta-openembedded/meta-networking \
  ${BSPDIR}/sources/meta-adakta \
  ${BSPDIR}/sources/meta-qt5 \
"
```

## sources/meta-adakta/conf/layer.conf
```bitbake
# We have a conf and classes directory, add to BBPATH
BBPATH .= ":${LAYERDIR}"

# We have a packages directory, add to BBFILES
BBFILES += "${LAYERDIR}/recipes-*/*/*.bb \
            ${LAYERDIR}/recipes-*/*/*.bbappend"

BBFILE_COLLECTIONS += "adakta"
BBFILE_PATTERN_adakta := "^${LAYERDIR}/"
BBFILE_PRIORITY_adakta = "4"
```

## sources/meta-adakta/conf/machine/adakta-adk.conf
```bitbake
#@TYPE: Machine
#@NAME: ADAKTA BSP for IMX6
#@SOC: i.MX6 Q/DL
#@DESCRIPTION: Machine configuration for Adakta ADK
#@MAINTAINER: Ilya Gorchakov <ilya.gorchakov@adakta.ru>
#
#
# By default, this machine will build for the standard Quad-Core, 1GB
# option.
#
# To build U-Boot for other CPU or memory combinations, you can set
# the UBOOT_MACHINE variable in your local.conf according to the
# following table:
#
# Processor           Memory    Configuration
# --------------      ------    --------------------
# i.MX6Quad/Dual        1GB     adakta_qd1g_config
# i.MX6Quad/Dual        2GB     adakta_qd2g_config
# i.MX6Quad/Dual        4GB     adakta_qd4g_config
# i.MX6Dual-Lite        1GB     adakta_dl1g_config
# i.MX6Dual-Lite        2GB     adakta_dl2g_config
# i.MX6Solo           512MB     adakta_s0g_config
# i.MX6Solo             1GB     adakta_s1g_config
#
#
#

MACHINEOVERRIDES =. "mx6:mx6dl:mx6q:"

include conf/machine/include/imx-base.inc
include conf/machine/include/tune-cortexa9.inc


KERNEL_DEVICETREE_adkstand = "imx6qp-adk_stand.dtb imx6qd-adk_stand.dtb imx6dls-adk_stand.dtb"
KERNEL_DEVICETREE_adk = "imx6qp-adk.dtb imx6qd-adk.dtb imx6dls-adk.dtb"

KERNEL_DEVICETREE = " \
${@bb.utils.contains_any("KERNEL_DEFCONFIG_TYPE", "adk", "${KERNEL_DEVICETREE_adk}" , "", d)} \
${@bb.utils.contains_any("KERNEL_DEFCONFIG_TYPE", "adkstand", "${KERNEL_DEVICETREE_adkstand}" , "", d)} \
"

KERNEL_IMAGETYPE = "zImage"

PREFERRED_PROVIDER_u-boot = "u-boot-adakta"
PREFERRED_PROVIDER_virtual/kernel ??= "linux-adk"

PREFERRED_PROVIDER_virtual/kernel_use-mainline-bsp ??= "linux-fslc"

# Use SPI NOR U-Boot by default
IMAGE_BOOTLOADER ?= ""

# Ensure boot scripts will be available at rootfs time
do_rootfs[depends] += "u-boot-script-adakta:do_deploy"

# Boot scripts to install
BOOT_SCRIPTS = "6x_bootscript-${MACHINE}:6x_bootscript"

IMAGE_BOOT_FILES = " \
    6x_bootscript-${MACHINE};6x_bootscript \
    ${KERNEL_IMAGETYPE} \
    ${KERNEL_IMAGETYPE}-imx6qp-adk.dtb;imx6qp-adk.dtb \
    ${KERNEL_IMAGETYPE}-imx6qd-adk.dtb;imx6qd-adk.dtb \
    ${KERNEL_IMAGETYPE}-imx6dls-adk.dtb;imx6dls-adk.dtb \ 
"

UBOOT_MACHINE ?= "imx6q-adk_config"

SERIAL_CONSOLE = "115200 ttymxc1"

MACHINE_ESSENTIAL_EXTRA_RDEPENDS += " \
    kernel-image \
    kernel-devicetree \
"

MACHINE_FEATURES += " pci"
```

## sources/meta-adakta/conf/machine/adakta-emx.conf
```bitbake
#@TYPE: Machine
#@NAME: ADAKTA BSP for IMX6 EMX module
#@SOC: i.MX6 Q/DL
#@DESCRIPTION: Machine configuration for Adakta EMX module
#@MAINTAINER: Ilya Gorchakov <ilya.gorchakov@adakta.ru>
#
#
# By default, this machine will build for the standard Quad-Core, 1GB
# option.
#
# To build U-Boot for other CPU or memory combinations, you can set
# the UBOOT_MACHINE variable in your local.conf according to the
# following table:
#
# Processor           Memory    Configuration
# --------------      ------    --------------------
# i.MX6Quad/Dual        1GB     adakta_qd1g_config
# i.MX6Quad/Dual        2GB     adakta_qd2g_config
# i.MX6Quad/Dual        4GB     adakta_qd4g_config
# i.MX6Dual-Lite        1GB     adakta_dl1g_config
# i.MX6Dual-Lite        2GB     adakta_dl2g_config
# i.MX6Solo           512MB     adakta_s0g_config
# i.MX6Solo             1GB     adakta_s1g_config
#
#
#

MACHINEOVERRIDES =. "mx6:mx6dl:mx6q:"

include conf/machine/include/imx-base.inc
include conf/machine/include/tune-cortexa9.inc


KERNEL_DEVICETREE_emxstand = "imx6qd-emx_stand.dtb imx6dls-emx_stand.dtb"
KERNEL_DEVICETREE_emx = "imx6qd-emx.dtb imx6dls-emx.dtb"

KERNEL_DEVICETREE = " \
${@bb.utils.contains_any("KERNEL_DEFCONFIG_TYPE", "emx", "${KERNEL_DEVICETREE_emx}" , "", d)} \
${@bb.utils.contains_any("KERNEL_DEFCONFIG_TYPE", "emxstand", "${KERNEL_DEVICETREE_emxstand}" , "", d)} \
"

KERNEL_IMAGETYPE = "zImage"

PREFERRED_PROVIDER_u-boot = "u-boot-adakta"
PREFERRED_PROVIDER_virtual/kernel ??= "linux-emx"

PREFERRED_PROVIDER_virtual/kernel_use-mainline-bsp ??= "linux-fslc"

# Use SPI NOR U-Boot by default
IMAGE_BOOTLOADER ?= ""

# Ensure boot scripts will be available at rootfs time
do_rootfs[depends] += "u-boot-script-adakta:do_deploy"

# Boot scripts to install
BOOT_SCRIPTS = "6x_bootscript-${MACHINE}:6x_bootscript"

IMAGE_BOOT_FILES = " \
    6x_bootscript-${MACHINE};6x_bootscript \
    ${KERNEL_IMAGETYPE} \
    ${KERNEL_IMAGETYPE}-${@bb.utils.contains_any("KERNEL_DEFCONFIG_TYPE", "emx", "imx6qd-emx.dtb;imx6dls-emx.dtb" , "", d)} \
    ${KERNEL_IMAGETYPE}-${@bb.utils.contains_any("KERNEL_DEFCONFIG_TYPE", "emxstand", "imx6qd-emx_stand.dtb;imx6dls-emx_stand.dtb" , "", d)} \
"

UBOOT_MACHINE ?= "adakta-emx6-qd2g_config"

SERIAL_CONSOLE = "115200 ttymxc1"

MACHINE_ESSENTIAL_EXTRA_RDEPENDS += " \
    kernel-image \
    kernel-devicetree \
"

MACHINE_FEATURES += " pci"
```

## sources/meta-adakta/conf/machine/adakta_nano6ull.conf
```bitbake
#@TYPE: Machine
#@NAME: ADAKTA BSP for IMX6ULL
#@SOC: i.MX6 ULL
#@DESCRIPTION: Machine configuration for Adakta ADK
#@MAINTAINER: Ilya Gorchakov <ilya.gorchakov@adakta.ru>
#
#
# By default, this machine will build for the standard Quad-Core, 1GB
# option.
#
# To build U-Boot for other CPU or memory combinations, you can set
# the UBOOT_MACHINE variable in your local.conf according to the
# following table:
#
# Processor           Memory    Configuration
# --------------      ------    --------------------
# i.MX6ULL        512MB     adakta_nano6ull_config
#
#
#

MACHINEOVERRIDES =. "mx6:mx6ull:"

include conf/machine/include/imx-base.inc
include conf/machine/include/tune-cortexa7.inc

KERNEL_DEFCONFIG_TYPE ??= "adakta_nano6ull"
KERNEL_DEVICETREE = "${KERNEL_DEFCONFIG_TYPE}.dtb ${KERNEL_DEFCONFIG_TYPE}_800.dtb ${KERNEL_DEFCONFIG_TYPE}_900.dtb"

 
KERNEL_IMAGETYPE = "zImage"

PREFERRED_PROVIDER_u-boot = "u-boot-adakta"
PREFERRED_PROVIDER_virtual/kernel ??= "linux-nano6ull"

PREFERRED_PROVIDER_virtual/kernel_use-mainline-bsp ??= "linux-fslc"

# Use SPI NOR U-Boot by default
IMAGE_BOOTLOADER ?= ""

# Ensure boot scripts will be available at rootfs time
do_rootfs[depends] += "u-boot-script-nano6ull:do_deploy"

# Boot scripts to install
BOOT_SCRIPTS = "6x_bootscript-${MACHINE}:6x_bootscript"

IMAGE_BOOT_FILES = " \
    6x_bootscript-${MACHINE};6x_bootscript \
    ${KERNEL_IMAGETYPE} \
    ${KERNEL_IMAGETYPE}-${KERNEL_DEFCONFIG_TYPE}.dtb \
    ${KERNEL_IMAGETYPE}-${KERNEL_DEFCONFIG_TYPE}_800.dtb \
    ${KERNEL_IMAGETYPE}-${KERNEL_DEFCONFIG_TYPE}_900.dtb \
"

UBOOT_MACHINE ?= "${KERNEL_DEFCONFIG_TYPE}_config"

SERIAL_CONSOLE = "115200 ttymxc0"
SYSVINIT_ENABLED_GETTYS = "0"

MACHINE_ESSENTIAL_EXTRA_RDEPENDS += " \
    kernel-image \
    kernel-devicetree \
"
```

## sources/meta-adakta/recipes-bsp/u-boot/u-boot-adakta-201807/git/board/adakta/adk/Kconfig
```kconfig
if TARGET_ADK

config SYS_BOARD
	default "adk"

config SYS_VENDOR
	default "adakta"

config SYS_CONFIG_NAME
	default "adk"

config SYS_SOC
	default "mx6"

endif
```

## sources/meta-adakta/recipes-bsp/u-boot/u-boot-adakta-201807/git/configs/imx6s1g-adk_defconfig
```kconfig
CONFIG_SYS_EXTRA_OPTIONS="IMX_CONFIG=board/adakta/adk/imx6s1g-adk.cfg,MX6S,DDR_MB=1024,DEFCONFIG=\"imx6s1g-adk\""
CONFIG_ARM=y
CONFIG_ARCH_MX6=y
CONFIG_SYS_TEXT_BASE=0x17800000
CONFIG_TARGET_ADK=y
CONFIG_VIDEO=y
CONFIG_CMD_HDMIDETECT=y
CONFIG_BOOTDELAY=3
CONFIG_SYS_CONSOLE_OVERWRITE_ROUTINE=y
# CONFIG_SYS_STDIO_DEREGISTER is not set
CONFIG_BOARD_EARLY_INIT_F=y
CONFIG_HUSH_PARSER=y
CONFIG_CMD_BOOTZ=y
# CONFIG_CMD_IMLS is not set
CONFIG_CMD_MEMTEST=y
# CONFIG_CMD_FLASH is not set
CONFIG_CMD_MMC=y
CONFIG_CMD_SF=y
CONFIG_CMD_I2C=y
CONFIG_CMD_USB=y
CONFIG_CMD_USB_MASS_STORAGE=y
CONFIG_CMD_GPIO=y
CONFIG_CMD_DHCP=y
CONFIG_CMD_MII=y
CONFIG_CMD_PING=y
CONFIG_CMD_BMP=y
CONFIG_CMD_CACHE=y
CONFIG_CMD_TIME=y
CONFIG_CMD_EXT2=y
CONFIG_CMD_EXT4=y
CONFIG_CMD_EXT4_WRITE=y
CONFIG_CMD_FAT=y
CONFIG_CMD_FS_GENERIC=y
CONFIG_EFI_PARTITION=y
CONFIG_PARTITION_TYPE_GUID=y
CONFIG_BLOCK_CACHE=y
CONFIG_SPI_FLASH=y
CONFIG_SPI_FLASH_SPANSION=y
CONFIG_SPI_FLASH_SST=y
CONFIG_USB=y
CONFIG_USB_STORAGE=y
CONFIG_USB_KEYBOARD=y
CONFIG_USB_GADGET=y
CONFIG_CI_UDC=y
CONFIG_USB_GADGET_DOWNLOAD=y
CONFIG_G_DNL_MANUFACTURER="Adakta"
CONFIG_G_DNL_VENDOR_NUM=0x0000
CONFIG_G_DNL_PRODUCT_NUM=0x0000
# CONFIG_VIDEO_SW_CURSOR is not set
CONFIG_OF_LIBFDT=y
CONFIG_USB_FUNCTION_MASS_STORAGE=y
CONFIG_IPUV3_CLK=264000000
CONFIG_FSL_ESDHC=y
CONFIG_ENV_IS_IN_SPI_FLASH=y
```
